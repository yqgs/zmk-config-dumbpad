## boards/shields/dumbpad/Kconfig.defconfig
```kconfig
# Copyright (c) 2022 The ZMK Contributors
# SPDX-License-Identifier: MIT

if SHIELD_DUMBPAD || SHIELD_DUMBPAD_OLED_TOP

config ZMK_KEYBOARD_NAME
	default "DumbPad"

endif
```

## boards/shields/dumbpad/Kconfig.shield
```kconfig
# Copyright (c) 2020 Nick Winans
# SPDX-License-Identifier: MIT

# config SHIELD_NICE60
config SHIELD_DUMBPAD
	def_bool $(shields_list_contains,dumbpad)
```
